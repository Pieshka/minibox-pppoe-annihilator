## extern/Config.in
```kconfig
source "$BR2_EXTERNAL_MINIBOX_PATH/package/webapi/Config.in"
source "$BR2_EXTERNAL_MINIBOX_PATH/package/limine/Config.in.host"

config BR2_MINIBOX_DEFAULT_WAN_INTERFACE
	string "Default WAN interface used by Minibox"
	default "eth0"

config BR2_MINIBOX_DEFAULT_LAN_INTERFACE
	string "Default LAN interface used by Minibox"
	default "eth1"

config BR2_MINIBOX_DEFAULT_IP
	string "Default IP"
	default "192.168.77.1"

config BR2_MINIBOX_DEFAULT_MASK
	string "Default netmask in short form"
	default "24"

config BR2_MINIBOX_VERSION
	string "Minibox version"
	default "1.0.0"
```

## extern/configs/minibox-generic_defconfig
```kconfig
BR2_x86_64=y
BR2_TOOLCHAIN_BUILDROOT_VENDOR="minibox"
BR2_TOOLCHAIN_BUILDROOT_MUSL=y
BR2_GLOBAL_PATCH_DIR="$(BR2_EXTERNAL_MINIBOX_PATH)/board/minibox/patches/"
BR2_TARGET_GENERIC_HOSTNAME="minibox"
BR2_TARGET_GENERIC_ISSUE="Minibox PPPoE Annihilator"
BR2_ROOTFS_DEVICE_TABLE="$(BR2_EXTERNAL_MINIBOX_PATH)/board/minibox/device_table.txt"
BR2_ROOTFS_MERGED_USR=y
BR2_TARGET_GENERIC_ROOT_PASSWD="minibox"
BR2_SYSTEM_DEFAULT_PATH="/bin:/sbin:/usr/bin:/usr/sbin"
BR2_ROOTFS_OVERLAY="$(BR2_EXTERNAL_MINIBOX_PATH)/board/minibox/rootfs_overlay"
BR2_ROOTFS_POST_BUILD_SCRIPT="$(BR2_EXTERNAL_MINIBOX_PATH)/board/minibox/post-build.sh"
BR2_ROOTFS_POST_IMAGE_SCRIPT="$(BR2_EXTERNAL_MINIBOX_PATH)/board/minibox/post-image.sh"
BR2_ROOTFS_POST_IMAGE_SCRIPT_ARGS="minibox-generic"
BR2_LINUX_KERNEL=y
BR2_LINUX_KERNEL_USE_CUSTOM_CONFIG=y
BR2_LINUX_KERNEL_CUSTOM_CONFIG_FILE="$(BR2_EXTERNAL_MINIBOX_PATH)/board/minibox/linux-generic.config"
BR2_LINUX_KERNEL_ZSTD=y
BR2_PACKAGE_BUSYBOX_CONFIG="$(BR2_EXTERNAL_MINIBOX_PATH)/board/minibox/busybox-generic.config"
BR2_PACKAGE_LINUX_FIRMWARE=y
BR2_PACKAGE_LINUX_FIRMWARE_BNX2=y
BR2_PACKAGE_LINUX_FIRMWARE_BNX2X=y
BR2_PACKAGE_LINUX_FIRMWARE_RTL_8169=y
# BR2_PACKAGE_IFUPDOWN_SCRIPTS is not set
BR2_PACKAGE_NFTABLES=y
BR2_PACKAGE_PPPD=y
# BR2_PACKAGE_URANDOM_SCRIPTS is not set
BR2_TARGET_ROOTFS_EXT2=y
BR2_TARGET_ROOTFS_EXT2_4=y
BR2_TARGET_ROOTFS_EXT2_LABEL="minibox"
BR2_TARGET_ROOTFS_EXT2_SIZE="16M"
BR2_TARGET_ROOTFS_EXT2_MKFS_OPTIONS="-O ^64bit,^dir_index"
# BR2_TARGET_ROOTFS_TAR is not set
BR2_PACKAGE_HOST_GENIMAGE=y
BR2_PACKAGE_WEBAPI=y
BR2_PACKAGE_HOST_LIMINE=y
BR2_MINIBOX_VERSION="1.0.2"
```

## extern/configs/minibox-nanopi-r2s_defconfig
```kconfig
BR2_aarch64=y
BR2_ARM_FPU_VFPV4=y
BR2_TOOLCHAIN_BUILDROOT_VENDOR="minibox"
BR2_TOOLCHAIN_BUILDROOT_MUSL=y
BR2_GLOBAL_PATCH_DIR="$(BR2_EXTERNAL_MINIBOX_PATH)/board/minibox/generic/patches/ $(BR2_EXTERNAL_MINIBOX_PATH)/board/minibox/arm64/patches/"
BR2_TARGET_GENERIC_HOSTNAME="minibox"
BR2_TARGET_GENERIC_ISSUE="Minibox PPPoE Annihilator"
BR2_ROOTFS_DEVICE_TABLE=""
BR2_ROOTFS_MERGED_USR=y
BR2_TARGET_GENERIC_ROOT_PASSWD="minibox"
BR2_SYSTEM_DEFAULT_PATH="/bin:/sbin:/usr/bin:/usr/sbin"
BR2_ROOTFS_OVERLAY="$(BR2_EXTERNAL_MINIBOX_PATH)/board/minibox/generic/rootfs_overlay $(BR2_EXTERNAL_MINIBOX_PATH)/board/minibox/arm64/rootfs_overlay"
BR2_ROOTFS_POST_BUILD_SCRIPT="$(BR2_EXTERNAL_MINIBOX_PATH)/board/minibox/generic/post-build.sh"
BR2_ROOTFS_POST_IMAGE_SCRIPT="$(BR2_EXTERNAL_MINIBOX_PATH)/board/minibox/arm64/post-image-nanopi-r2s.sh"
BR2_ROOTFS_POST_BUILD_SCRIPT_ARGS="minibox-nanopi-r2s"
BR2_ROOTFS_POST_IMAGE_SCRIPT_ARGS="minibox-nanopi-r2s"
BR2_LINUX_KERNEL=y
BR2_LINUX_KERNEL_PATCH="$(BR2_EXTERNAL_MINIBOX_PATH)/board/minibox/arm64/linux_patches/rockchip"
BR2_LINUX_KERNEL_USE_CUSTOM_CONFIG=y
BR2_LINUX_KERNEL_CUSTOM_CONFIG_FILE="$(BR2_EXTERNAL_MINIBOX_PATH)/board/minibox/arm64/linux-nanopi-r2s.config"
BR2_LINUX_KERNEL_ZSTD=y
BR2_LINUX_KERNEL_DTS_SUPPORT=y
BR2_LINUX_KERNEL_INTREE_DTS_NAME="rockchip/rk3328-nanopi-r2s"
BR2_PACKAGE_BUSYBOX_CONFIG="$(BR2_EXTERNAL_MINIBOX_PATH)/board/minibox/arm64/busybox-nanopi-r2s.config"
BR2_PACKAGE_LINUX_FIRMWARE=y
BR2_PACKAGE_LINUX_FIRMWARE_RTL_815X=y
BR2_PACKAGE_INPUT_EVENT_DAEMON=y
# BR2_PACKAGE_IFUPDOWN_SCRIPTS is not set
BR2_PACKAGE_NFTABLES=y
BR2_PACKAGE_PPPD=y
# BR2_PACKAGE_URANDOM_SCRIPTS is not set
BR2_TARGET_ROOTFS_EXT2=y
BR2_TARGET_ROOTFS_EXT2_4=y
BR2_TARGET_ROOTFS_EXT2_LABEL="minibox"
BR2_TARGET_ROOTFS_EXT2_SIZE="16M"
BR2_TARGET_ROOTFS_EXT2_MKFS_OPTIONS="-O ^64bit,^dir_index"
# BR2_TARGET_ROOTFS_TAR is not set
BR2_TARGET_ARM_TRUSTED_FIRMWARE=y
BR2_TARGET_ARM_TRUSTED_FIRMWARE_LATEST_LTS_2_12_VERSION=y
BR2_TARGET_ARM_TRUSTED_FIRMWARE_PLATFORM="rk3328"
BR2_TARGET_ARM_TRUSTED_FIRMWARE_IMAGES=""
BR2_TARGET_ARM_TRUSTED_FIRMWARE_NEEDS_ARM32_TOOLCHAIN=y
BR2_TARGET_UBOOT=y
BR2_TARGET_UBOOT_USE_CUSTOM_CONFIG=y
BR2_TARGET_UBOOT_CUSTOM_CONFIG_FILE="$(BR2_EXTERNAL_MINIBOX_PATH)/board/minibox/arm64/uboot-nanopi-r2s.config"
BR2_TARGET_UBOOT_NEEDS_DTC=y
BR2_TARGET_UBOOT_NEEDS_PYLIBFDT=y
BR2_TARGET_UBOOT_NEEDS_PYELFTOOLS=y
BR2_TARGET_UBOOT_NEEDS_OPENSSL=y
BR2_TARGET_UBOOT_NEEDS_GNUTLS=y
BR2_TARGET_UBOOT_NEEDS_ATF_BL31=y
BR2_TARGET_UBOOT_NEEDS_ATF_BL31_ELF=y
BR2_TARGET_UBOOT_FORMAT_CUSTOM=y
BR2_TARGET_UBOOT_FORMAT_CUSTOM_NAME="u-boot.itb"
BR2_TARGET_UBOOT_SPL=y
BR2_TARGET_UBOOT_SPL_NAME="idbloader.img"
BR2_PACKAGE_HOST_GENIMAGE=y
BR2_PACKAGE_HOST_UBOOT_TOOLS=y
BR2_PACKAGE_WEBAPI=y
BR2_PACKAGE_MINIMDNSD=y
BR2_MINIBOX_VERSION="1.0.7"
```

## extern/package/limine/Config.in.host
```kconfig
config BR2_PACKAGE_HOST_LIMINE
    bool "host-limine"
    help
        Limine bootloader used in Minibox
```

## extern/package/minimdnsd/Config.in
```kconfig
config BR2_PACKAGE_MINIMDNSD
    bool "minimdnsd"
    help
        Extremely simple MDNS server for Linux. 
        Much smaller and lighter weight than Avahi.

        Project: https://github.com/cnlohr/minimdnsd
```

## extern/package/webapi/Config.in
```kconfig
config BR2_PACKAGE_WEBAPI
	bool "webapi"
	help
		A CGI application providing a web API for 
		configuring the Minibox PPPoE Annihilator. 
		If there is no need to operate the device 
		via the web panel, the API can be disabled.
```
